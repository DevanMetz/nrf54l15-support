## CMakeLists.txt
```
cmake_minimum_required(VERSION 3.20.0)
find_package(Zephyr REQUIRED HINTS $ENV{ZEPHYR_BASE})
project(adc_poll)
if(NOT TARGET nrf54l15_core)
  add_subdirectory(../../lib/nrf54l15 ${CMAKE_CURRENT_BINARY_DIR}/nrf54l15)
endif()
target_sources(app PRIVATE src/main.c)
target_link_libraries(app PRIVATE nrf54l15_drivers)
```

## prj.conf
```kconfig
CONFIG_ADC=y
CONFIG_PRINTK=y
CONFIG_CONSOLE=y
CONFIG_UART_CONSOLE=y
CONFIG_SENSOR=n
CONFIG_MAIN_STACK_SIZE=2048
```

## app.overlay
```dts
/* NCS 3.3.0 XIAO board: AIN0 = P1.04 = XIAO D0/A0.
 * The board supplies gain 1/4, internal reference, 12 bits, oversampling=8.
 */
/ {
	zephyr,user {
		io-channels = <&adc 0>;
	};
};
```

## src/main.c
```c
/* SPDX-License-Identifier: Apache-2.0 */
#include <zephyr/kernel.h>
#include <nrf54l15/adc.h>

static const struct adc_dt_spec input = ADC_DT_SPEC_GET(DT_PATH(zephyr_user));

int main(void)
{
	struct nrf54l15_adc channel;
	int err = nrf54l15_adc_init(&channel, &input);
	if (err) {
		printk("# ADC init failed: %d\n", err);
		return err;
	}
	printk("# ADC,uptime_us,raw,input_millivolts (XIAO D0/A0)\n");
	while (true) {
		struct nrf54l15_adc_sample sample;
		err = nrf54l15_adc_read(&channel, false, &sample);
		if (err) {
			printk("# ADC read failed: %d\n", err);
		} else {
			printk("ADC,%llu,%d,%d\n", (unsigned long long)sample.timestamp_us,
			       sample.raw, sample.millivolts);
		}
		k_sleep(K_MSEC(100));
	}
}
```
