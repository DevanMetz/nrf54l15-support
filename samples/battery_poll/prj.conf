## CMakeLists.txt
```
cmake_minimum_required(VERSION 3.20.0)
find_package(Zephyr REQUIRED HINTS $ENV{ZEPHYR_BASE})
project(battery_poll)
if(NOT TARGET nrf54l15_core)
  add_subdirectory(../../lib/nrf54l15 ${CMAKE_CURRENT_BINARY_DIR}/nrf54l15)
endif()
target_sources(app PRIVATE src/main.c)
target_link_libraries(app PRIVATE nrf54l15_drivers)
```

## prj.conf
```kconfig
CONFIG_ADC=y
CONFIG_GPIO=y
CONFIG_REGULATOR=y
CONFIG_REGULATOR_FIXED=y
CONFIG_PRINTK=y
CONFIG_CONSOLE=y
CONFIG_UART_CONSOLE=y
CONFIG_SENSOR=n
CONFIG_MAIN_STACK_SIZE=2048
```

## standalone.conf
```kconfig
# Seeed hardware v1.0: disable UART for operation without USB/debug-bridge power.
# RTT output can be inspected with an attached compatible debug probe.
CONFIG_SERIAL=n
CONFIG_UART_CONSOLE=n
CONFIG_USE_SEGGER_RTT=y
CONFIG_RTT_CONSOLE=y
CONFIG_SEGGER_RTT_MODE_NO_BLOCK_SKIP=y
```

## app.overlay
```dts
/* XIAO Sense schematic v0.9: R5/R6 = 10k/10k, P1.14 = AIN7.
 * P1.15 controls the divider's TPS22916 switch, not the board's main supply.
 */
/ {
	zephyr,user {
		io-channels = <&adc 7>;
	};
};
&vbat_pwr {
	/delete-property/ regulator-boot-on;
	/delete-property/ regulator-always-on;
};
```

## src/main.c
```c
/* SPDX-License-Identifier: Apache-2.0 */
#include <zephyr/kernel.h>
#include <nrf54l15/battery.h>

static struct nrf54l15_battery battery;

int main(void)
{
	const struct adc_dt_spec adc = ADC_DT_SPEC_GET(DT_PATH(zephyr_user));
	const struct nrf54l15_battery_config config = {
		.full_ohms = 20000,
		.output_ohms = 10000,
		.settle_ms = 100,
	};
	int err = nrf54l15_battery_init(&battery, &adc,
		DEVICE_DT_GET(DT_NODELABEL(vbat_pwr)), &config);
	if (err) {
		printk("# BATTERY init failed: %d\n", err);
		return 0;
	}
	printk("# BATTERY,uptime_us,raw,input_mv,battery_mv\n");
	for (uint32_t count = 0; ; ++count) {
		struct nrf54l15_battery_sample sample;
		/* Calibrate on first read and explicitly again every 60 measurements. */
		err = nrf54l15_battery_read(&battery, count % 60 == 0, &sample);
		if (err) {
			int release_err = nrf54l15_battery_release(&battery);
			printk("# BATTERY read failed: %d; release retry=%d; held=%u\n",
				err, release_err, (unsigned int)battery.power_held);
			return 0;
		}
		printk("BATTERY,%llu,%d,%d,%d\n",
			(unsigned long long)sample.input.timestamp_us, (int)sample.input.raw,
			sample.input.millivolts, sample.millivolts);
		k_sleep(K_MSEC(1000));
	}
}
```
