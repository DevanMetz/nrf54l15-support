/* Keep the shared sensor/microphone rail powered. The sample controls only
 * the IMU's sampling registers; it does not switch this supply.
 */
&lsm6ds3tr_c {
	status = "disabled";
};
&pdm_imu_pwr {
	regulator-always-on;
};
&imu_power_default_on {
	output-high;
};
